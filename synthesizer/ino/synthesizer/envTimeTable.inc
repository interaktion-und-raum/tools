    1, 5, 9, 14, 19, 26, 34, 42, 53, 65, 79, 95, 113, 134, 157, 182, 211, 243, 278, 317, 359, 405, 456, 511, 570, 633, 702, 776, 854, 939, 1029, 1124, 1226, 1333, 1448, 1568, 1695, 1829, 1971, 2119, 2274, 2438, 2610, 2789, 2977, 3172, 3377, 3590, 3813, 4044, 4285, 4535, 4795, 5065, 5345, 5635, 5936, 6247, 6569, 6902, 7247, 7602, 7970, 8349, 8740, 9143, 9559, 9986, 10427, 10880, 11347, 11827, 12321, 12828, 13349, 13883, 14433, 14996, 15574, 16167, 16775, 17398, 18036, 18690, 19359, 20045, 20746, 21464, 22198, 22949, 23716, 24501, 25303, 26122, 26959, 27813, 28686, 29577, 30486, 31413, 32359, 33325, 34309, 35312, 36335, 37378, 38440, 39522, 40625, 41748, 42892, 44056, 45241, 46448, 47675, 48925, 50196, 51489, 52803, 54141, 55500, 56883, 58288, 59716, 61167, 62642, 64140, 65662
