    1, 5, 9, 13, 17, 21, 26, 30, 35, 39, 44, 49, 54, 59, 64, 69, 74, 79, 85, 90, 96, 101, 107, 113, 119, 125, 132, 138, 144, 151, 158, 165, 172, 179, 187, 194, 202, 210, 218, 226, 234, 243, 252, 261, 270, 279, 289, 299, 309, 320, 330, 341, 353, 364, 376, 388, 401, 414, 427, 440, 455, 469, 484, 500, 516, 532, 549, 566, 584, 602, 622, 642, 663, 684, 706, 729, 753, 778, 804, 831, 859, 888, 919, 951, 984, 1019, 1056, 1094, 1134, 1176, 1221, 1268, 1317, 1370, 1425, 1484, 1547, 1614, 1684, 1760, 1841, 1929, 2023, 2125, 2234, 2354, 2484, 2627, 2785, 2959, 3152, 3368, 3611, 3886, 4201, 4563, 4987, 5487, 6087, 6821, 7739, 8918, 10491, 12693, 15996, 21500, 32509, 65535
